#include <physical_layouts.dtsi>
#include <dt-bindings/zmk/matrix_transform.h>
/ {
    chosen {
        zmk,kscan = &kscan0;
    };

    kscan0: kscan {
        compatible = "zmk,kscan-gpio-matrix";

        row-gpios = <&pro_micro 2 (GPIO_ACTIVE_HIGH | GPIO_PULL_DOWN)>,
                    <&pro_micro 3 (GPIO_ACTIVE_HIGH | GPIO_PULL_DOWN)>;

        col-gpios = <&pro_micro 4 GPIO_ACTIVE_HIGH>,
                    <&pro_micro 5 GPIO_ACTIVE_HIGH>;

        diode-direction = "row2col";
    };
};
